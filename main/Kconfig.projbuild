## main/Kconfig.projbuild
```kconfig
menu "flatpack2ctl Configuration"

    config TWAI_TX_GPIO_NUM
        int "CAN tranceiver TX GPIO number"
        default 27
        help
            This option selects the GPIO pin used for CAN transmit. Default to GPIO_NUM_27

    config TWAI_RX_GPIO_NUM
        int "CAN tranceiver RX GPIO number"
        default 26
        help
            This option selects the GPIO pin used for CAN receive. Default to GPIO_NUM_26

    config TWAI_SLOPE_GPIO_NUM
        int "CAN tranceiver slope control GPIO number"
        default 23
        help
            This option selects the GPIO pin used for CAN slope control.
            Can improve stability in CAN transmission. Default to GPIO_NUM_23

    config STATUS_LED_GPIO_NUM
        int "Status LED GPIO number"
        default 4
        help
            This option selects the GPIO pin used for the status LED control. Default to GPIO_NUM_4

    config RELAY_GPIO_NUM
        int "Relay GPIO number"
        default 18
        help
            This option selects the GPIO pin used for the relay control. For pin configured as GPIO_MODE_OUTPUT
            gpio_get_level always return 0 so get it state direct from GPIO_OUT0_REG
            #define RELAY_GPIO_GET_LEVEL_DIRECT ((GPIO_REG_READ(GPIO_OUT0_REG) >> (RELAY_GPIO)) & 0x1)
            Default to GPIO_NUM_18. If you want use GPIO > 31 do modify RELAY_GPIO_GET_LEVEL_DIRECT macro

    config POWERMETER_UART_RX_GPIO_NUM
        int "Power meter HLW8032 RX GPIO number"
        default 21
        help
            This option selects the GPIO pin used for receive power meter UART data from HLW8032. Default to GPIO_NUM_21

    config POWERMETER_UART_TX_GPIO_NUM
        int "Power meter HLW8032 TX GPIO number"
        default 22
        help
            This option selects the GPIO pin used for transmit UART data. Transmission not used but pin should be defined.
            Default to GPIO_NUM_22

endmenu
```

## sdkconfig.defaults
```kconfig
CONFIG_ESPTOOLPY_FLASHSIZE_4MB=y
CONFIG_ESPTOOLPY_FLASHMODE_QIO=y
CONFIG_ESPTOOLPY_FLASHFREQ_80M=y
CONFIG_ESP_DEFAULT_CPU_FREQ_MHZ_240=y

CONFIG_BOOTLOADER_LOG_LEVEL_WARN=y
CONFIG_LOG_DEFAULT_LEVEL_INFO=y

CONFIG_COMPILER_OPTIMIZATION_PERF=y

CONFIG_PARTITION_TABLE_CUSTOM=y

CONFIG_ETH_ENABLED=n
CONFIG_ETH_USE_SPI_ETHERNET=n

CONFIG_ESP_WIFI_NVS_ENABLED=y

CONFIG_LWIP_IPV6_AUTOCONFIG=y
CONFIG_LWIP_LOCAL_HOSTNAME="flatpack2ctl"
CONFIG_LWIP_MAX_SOCKETS=16
CONFIG_HTTPD_MAX_REQ_HDR_LEN=1024

CONFIG_TWAI_ISR_IN_IRAM=y

CONFIG_BOOTLOADER_WDT_DISABLE_IN_USER_CODE=n

# CONFIG_FREERTOS_USE_STATS_FORMATTING_FUNCTIONS=y
# CONFIG_FREERTOS_GENERATE_RUN_TIME_STATS=y
# CONFIG_FREERTOS_USE_TRACE_FACILITY=y
```
